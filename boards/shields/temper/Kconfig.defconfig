## boards/shields/temper/Kconfig.defconfig
```kconfig
# Copyright (c) 2020 The ZMK Contributors
# SPDX-License-Identifier: MIT

if SHIELD_TEMPER_CENTRAL_DONGLE_128x64 || SHIELD_TEMPER_CENTRAL_DONGLE_128x32

config ZMK_KEYBOARD_NAME
	default "Temper Dongle"
	
config ZMK_SPLIT_BLE_ROLE_CENTRAL
	default y
	
config ZMK_USB
	default y

endif

if SHIELD_TEMPER_CENTRAL_LEFT

config ZMK_KEYBOARD_NAME
	default "Temper"
	
config ZMK_SPLIT_BLE_ROLE_CENTRAL
	default y
	
config ZMK_USB
	default y

endif


if SHIELD_TEMPER_CENTRAL_DONGLE_128x64 || SHIELD_TEMPER_CENTRAL_DONGLE_128x32 || SHIELD_TEMPER_CENTRAL_LEFT || SHIELD_TEMPER_PERIPHERAL_LEFT || SHIELD_TEMPER_PERIPHERAL_RIGHT

config ZMK_SPLIT
	default y

config ZMK_BLE
	default y
	
endif
```

## boards/shields/temper/Kconfig.shield
```kconfig
# Copyright (c) 2020 Pete Johanson
# SPDX-License-Identifier: MIT


config SHIELD_TEMPER_CENTRAL_DONGLE_128x64
    def_bool $(shields_list_contains,temper_central_dongle_128x64) 

config SHIELD_TEMPER_CENTRAL_DONGLE_128x32
    def_bool $(shields_list_contains,temper_central_dongle_128x32) 

config SHIELD_TEMPER_CENTRAL_LEFT
    def_bool $(shields_list_contains,temper_central_left)

config SHIELD_TEMPER_PERIPHERAL_LEFT
    def_bool $(shields_list_contains,temper_peripheral_left)

config SHIELD_TEMPER_PERIPHERAL_RIGHT
    def_bool $(shields_list_contains,temper_peripheral_right)
```

## config/boards/shields/temper/Kconfig.shield
```kconfig
# Copyright (c) 2020 Pete Johanson
# SPDX-License-Identifier: MIT


config SHIELD_TEMPER_CENTRAL_DONGLE
    def_bool $(shields_list_contains,temper_central_dongle) 

config SHIELD_TEMPER_CENTRAL_LEFT
    def_bool $(shields_list_contains,temper_central_left)

config SHIELD_TEMPER_PERIPHERAL_LEFT
    def_bool $(shields_list_contains,temper_peripheral_left)

config SHIELD_TEMPER_PERIPHERAL_RIGHT
    def_bool $(shields_list_contains,temper_peripheral_right)
```
